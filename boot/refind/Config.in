## boot/refind/Config.in
```kconfig
if PACKAGE_refind

choice
        prompt "Selected library that refind is built-on"
        default REFIND_TIANOCORE

        config REFIND_TIANOCORE
                bool "TianoCore EDK2"

        config REFIND_GNUEFI
                bool "GNU-EFI"
endchoice

choice
	prompt "Architechture"
	default REFIND_X64

	config REFIND_X64
		bool "x64"

	config REFIND_IA32
		bool "ia32"
endchoice

endif
```

## boot/refindplus/Config.in
```kconfig
if PACKAGE_refindplus

choice
        prompt "Version"
        default REFINDPLUS_RELEASE

        config REFINDPLUS_RELEASE
                bool "Release"

        config REFINDPLUS_DEBUG
                bool "Debug"
endchoice

endif
```

## kernel/usbfb/files/Kconfig
```kconfig
menuconfig USBFB_VOCORE_SCREEN
	tristate "Support for VoCore Screen"
	depends on FB && USB
	select FB_SYS_COPYAREA
	select FB_SYS_FILLRECT
	select FB_SYS_IMAGEBLIT
	select FB_SYS_FOPS
```

## utils/openwrt-banner/Config.in
```kconfig
menu "Configuration"
	depends on PACKAGE_openwrt-banner

config OPENWRT_BANNER_RELEASE
	string "Hardcode custom release version"
	default ""
	help
	  Forces customized release version

endmenu
```

## utils/pax-utils/Config.in
```kconfig
enu "Configuration"
	depends on PACKAGE_pax-utils

config PAX_UTILS_SECCOMP
	bool "build with support for seccomp"
	default n
```

## utils/splash-drm/Config.in
```kconfig
menu "Configuration"
	depends on PACKAGE_splash-drm

config SPLASH_DRM_FONTS
	bool "include fonts"
	default y

config SPLASH_DRM_SAMPLE_IMAGE
	bool "include sample image"
	default y

endmenu
```

## utils/splash/Config.in
```kconfig
menu "Configuration"
	depends on PACKAGE_splash

config SPLASH_JPG
	bool "enable support for jpeg image format"
	default n

config SPLASH_BMP
	bool "enable support for bmp image format"
	default n

endmenu
```
